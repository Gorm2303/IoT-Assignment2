## main/Kconfig.projbuild
```kconfig
menu "Project Configuration"

config WIFI_SSID
    string "Example SSID"
    default "SkyNet"
    
config WIFI_PASSWORD
    string "Example Password"
    default "Summer2303"
    
config MQTT_BROKER
	string "Example Broker"
	default "mqtt://broker.hivemq.com"

config MQTT_COMMAND_TOPIC
	string "Example Command Topic"
	default "org/sdu/2024/iot/my/name/command"

config MQTT_RESPONSE_TOPIC
	string "Example Response Topic"
	default "org/sdu/2024/iot/my/name/response"

endmenu
```
